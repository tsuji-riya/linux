## Documentation/devicetree/bindings/clock/celestial,cnc1800l-clk.yaml
```yaml
# SPDX-License-Identifier: (GPL-2.0-only OR BSD-2-Clause)
%YAML 1.2
---
$id: http://devicetree.org/schemas/clock/celestial,cnc1800l-clk.yaml#
$schema: http://devicetree.org/meta-schemas/core.yaml#

title: Celestial Semiconductor CNC1800L Clock/Reset Controller

description:
  This node represents the CNC1800L SoC's combined clock-generator /
  power-control / reset register block. The vendor driver implements this
  block as roughly 90 ad-hoc register-poking functions rather than a
  clock-framework provider, covering many domains (display, audio, HDMI,
  transport, graphics...) that mainline Linux has no framework support for
  on this SoC. This binding currently only describes the USB PHY gate
  clocks and USB reset line; most peripherals on this SoC that need a
  clock from this block (UART, the timers, NAND, I2C, GPIO) run off an
  always-on fixed rate and are described with plain "fixed-clock" nodes
  instead, since the vendor driver never gates them.

maintainers:
  - Riya Tsuji <tsuji.riya@gmail.com>

properties:
  compatible:
    const: celestial,cnc1800l-clk

  reg:
    maxItems: 1

  '#clock-cells':
    const: 1
    description: |
      0 = usb0-phy gate clock
      1 = usb1-phy gate clock

  '#reset-cells':
    const: 1
    description: |
      0 = USB reset line

required:
  - compatible
  - reg
  - '#clock-cells'
  - '#reset-cells'

additionalProperties: false

examples:
  - |
    clock-controller@b2100000 {
        compatible = "celestial,cnc1800l-clk";
        reg = <0xb2100000 0x1000>;
        #clock-cells = <1>;
        #reset-cells = <1>;
    };
...
```

## Documentation/devicetree/bindings/gpio/celestial,cnc1800l-gpio.yaml
```yaml
# SPDX-License-Identifier: (GPL-2.0-only OR BSD-2-Clause)
%YAML 1.2
---
$id: http://devicetree.org/schemas/gpio/celestial,cnc1800l-gpio.yaml#
$schema: http://devicetree.org/meta-schemas/core.yaml#

title: Celestial Semiconductor CNC1800L GPIO Controller

description:
  64 GPIO lines split across two 32-bit ports, each with a DR (output
  data) / DDR (direction) / EXT_PORT (input data) register triplet.
  Direction polarity is inverted from the usual convention (the DDR bit is
  set for input, clear for output). This controller does not yet have a
  cascaded irqchip implementation, even though the hardware does demux all
  64 lines onto one parent interrupt.

maintainers:
  - Riya Tsuji <tsuji.riya@gmail.com>

allOf:
  - $ref: gpio.yaml#

properties:
  compatible:
    const: celestial,cnc1800l-gpio

  reg:
    maxItems: 1

  gpio-controller: true

  '#gpio-cells':
    const: 2

  ngpios:
    default: 64
    maximum: 64

required:
  - compatible
  - reg
  - gpio-controller
  - '#gpio-cells'

unevaluatedProperties: false

examples:
  - |
    gpio@80260000 {
        compatible = "celestial,cnc1800l-gpio";
        reg = <0x80260000 0x100>;
        gpio-controller;
        #gpio-cells = <2>;
        ngpios = <64>;
    };
...
```

## Documentation/devicetree/bindings/interrupt-controller/celestial,cnc1800l-vic.yaml
```yaml
# SPDX-License-Identifier: (GPL-2.0-only OR BSD-2-Clause)
%YAML 1.2
---
$id: http://devicetree.org/schemas/interrupt-controller/celestial,cnc1800l-vic.yaml#
$schema: http://devicetree.org/meta-schemas/core.yaml#

title: Celestial Semiconductor CNC1800L Vectored Interrupt Controller

description:
  Single-level, 32-line, level-triggered-only interrupt controller found on
  the Celestial Semiconductor CNC1800L SoC. It is always the root interrupt
  controller (there is no secondary/cascaded controller on this SoC) and is
  never chained onto another interrupt source.

maintainers:
  - Riya Tsuji <tsuji.riya@gmail.com>

allOf:
  - $ref: /schemas/interrupt-controller.yaml#

properties:
  compatible:
    const: celestial,cnc1800l-vic

  reg:
    maxItems: 1

  interrupt-controller: true

  '#interrupt-cells':
    const: 1

required:
  - compatible
  - reg
  - interrupt-controller
  - '#interrupt-cells'

additionalProperties: false

examples:
  - |
    interrupt-controller@80140000 {
        compatible = "celestial,cnc1800l-vic";
        reg = <0x80140000 0x100>;
        interrupt-controller;
        #interrupt-cells = <1>;
    };
...
```

## Documentation/devicetree/bindings/mtd/celestial,cnc1800l-nand.yaml
```yaml
# SPDX-License-Identifier: (GPL-2.0-only OR BSD-2-Clause)
%YAML 1.2
---
$id: http://devicetree.org/schemas/mtd/celestial,cnc1800l-nand.yaml#
$schema: http://devicetree.org/meta-schemas/core.yaml#

title: Celestial Semiconductor CNC1800L NAND controller

description:
  A memory-mapped, ALE/CLE-address-line NAND controller with a per-chip
  select "force CE low" config register and a 1-bit hardware ECC engine
  addressed by writing the physical byte address being accessed into an
  ECC_A register. Conceptually similar to (but not register-compatible
  with) the TI DaVinci AEMIF NAND controller's 1-bit ECC mode.

maintainers:
  - Riya Tsuji <tsuji.riya@gmail.com>

allOf:
  - $ref: nand-controller.yaml

properties:
  compatible:
    const: celestial,cnc1800l-nand

  reg:
    items:
      - description: SMC control/ECC registers
      - description: Memory-mapped NAND data window

  reg-names:
    items:
      - const: smc
      - const: data

  celestial,mask-ale:
    description: Address-line bit ORed into the data window to assert ALE.
    $ref: /schemas/types.yaml#/definitions/uint32
    default: 8

  celestial,mask-cle:
    description: Address-line bit ORed into the data window to assert CLE.
    $ref: /schemas/types.yaml#/definitions/uint32
    default: 4

required:
  - compatible
  - reg
  - reg-names

unevaluatedProperties: false

examples:
  - |
    nand-controller@80100000 {
        compatible = "celestial,cnc1800l-nand";
        reg = <0x80100000 0x48>, <0xa4000000 0x2000000>;
        reg-names = "smc", "data";
        #address-cells = <1>;
        #size-cells = <0>;
    };
...
```

## Documentation/devicetree/bindings/pinctrl/celestial,cnc1800l-pinctrl.yaml
```yaml
# SPDX-License-Identifier: (GPL-2.0-only OR BSD-2-Clause)
%YAML 1.2
---
$id: http://devicetree.org/schemas/pinctrl/celestial,cnc1800l-pinctrl.yaml#
$schema: http://devicetree.org/meta-schemas/core.yaml#

title: Celestial Semiconductor CNC1800L Pin Mux Controller

description:
  The CNC1800L pin mux is a set of 16-bit "group enable" registers, each
  gating a whole bank of pins between GPIO and one on-chip peripheral
  rather than offering a per-pin function field. Each hardware group is
  modelled as one pinmux function with exactly one group of the same name;
  individual pin numbers are not described since no authoritative per-pin
  table is available for this SoC.

maintainers:
  - Riya Tsuji <tsuji.riya@gmail.com>

properties:
  compatible:
    const: celestial,cnc1800l-pinctrl

  reg:
    maxItems: 1

patternProperties:
  '-pins$':
    type: object
    additionalProperties: false
    properties:
      groups:
        description: Name of the pin group to configure.
        $ref: /schemas/types.yaml#/definitions/string
      function:
        description: Function to select for this group.
        $ref: /schemas/types.yaml#/definitions/string
    required:
      - groups
      - function

required:
  - compatible
  - reg

additionalProperties: false

examples:
  - |
    pinctrl@b2110000 {
        compatible = "celestial,cnc1800l-pinctrl";
        reg = <0xb2110000 0x100>;

        i2c0_pins: i2c0-pins {
            groups = "i2c0";
            function = "i2c0";
        };
    };
...
```

## Documentation/devicetree/bindings/timer/celestial,cnc1800l-timer.yaml
```yaml
# SPDX-License-Identifier: (GPL-2.0-only OR BSD-2-Clause)
%YAML 1.2
---
$id: http://devicetree.org/schemas/timer/celestial,cnc1800l-timer.yaml#
$schema: http://devicetree.org/meta-schemas/core.yaml#

title: Celestial Semiconductor CNC1800L Timer

description:
  Combines the SoC's two independent timer IP blocks into a single time
  base, matching the vendor board code's usage of them as one unit - the
  "ahb" block (a 32-bit down-counter with a one-shot/periodic mode bit) as
  the clockevent, and the "apb" block (a free-running dual DesignWare-APB
  timer instance used as a single continuous counter) as the clocksource.

maintainers:
  - Riya Tsuji <tsuji.riya@gmail.com>

properties:
  compatible:
    const: celestial,cnc1800l-timer

  reg:
    items:
      - description: AHB timer (clockevent) registers
      - description: APB timer (clocksource) registers

  reg-names:
    items:
      - const: ahb
      - const: apb

  interrupts:
    maxItems: 1
    description: AHB timer interrupt

  clocks:
    items:
      - description: AHB timer input clock
      - description: APB timer input clock

  clock-names:
    items:
      - const: ahb
      - const: apb

required:
  - compatible
  - reg
  - reg-names
  - interrupts
  - clocks
  - clock-names

additionalProperties: false

examples:
  - |
    timer@80270000 {
        compatible = "celestial,cnc1800l-timer";
        reg = <0x80270000 0x30>, <0x801e2000 0xb0>;
        reg-names = "ahb", "apb";
        interrupts = <4>;
        clocks = <&ahb_timer_clk>, <&pclk>;
        clock-names = "ahb", "apb";
    };
...
```

## arch/arm/configs/cnc1800l_tigamini_defconfig
```kconfig
CONFIG_SYSVIPC=y
CONFIG_NO_HZ=y
CONFIG_HIGH_RES_TIMERS=y
CONFIG_BLK_DEV_INITRD=y
CONFIG_EXPERT=y
# CONFIG_VM_EVENT_COUNTERS is not set
# CONFIG_SLUB_DEBUG is not set
# CONFIG_COMPAT_BRK is not set
CONFIG_ARCH_MULTI_V6=y
# CONFIG_ARCH_MULTI_V7 is not set
CONFIG_ARCH_CELESTIAL=y
CONFIG_AEABI=y
CONFIG_ZBOOT_ROM_TEXT=0x0
CONFIG_ZBOOT_ROM_BSS=0x0
CONFIG_CMDLINE="console=ttyS0,115200n8 root=/dev/mtdblock18 rootfstype=jffs2"
CONFIG_CPU_IDLE=y
CONFIG_VFP=y
CONFIG_NET=y
CONFIG_PACKET=y
CONFIG_UNIX=y
CONFIG_INET=y
CONFIG_IP_PNP=y
# CONFIG_IPV6 is not set
CONFIG_MTD=y
CONFIG_MTD_CMDLINE_PARTS=y
CONFIG_MTD_BLOCK=y
CONFIG_MTD_RAW_NAND=y
CONFIG_MTD_NAND_CNC1800L=y
CONFIG_MTD_UBI=y
CONFIG_BLK_DEV_LOOP=y
CONFIG_NETDEVICES=y
CONFIG_USB_USBNET=y
CONFIG_USB_NET_AX8817X=y
CONFIG_WIRELESS=y
CONFIG_CFG80211=y
CONFIG_ATH6KL=y
CONFIG_ATH6KL_SDIO=y
CONFIG_INPUT_EVDEV=y
# CONFIG_SERIO is not set
# CONFIG_VT is not set
CONFIG_SERIAL_8250=y
CONFIG_SERIAL_8250_CONSOLE=y
CONFIG_SERIAL_8250_NR_UARTS=2
CONFIG_SERIAL_8250_RUNTIME_UARTS=2
CONFIG_SERIAL_8250_DW=y
CONFIG_SERIAL_OF_PLATFORM=y
# CONFIG_HW_RANDOM is not set
CONFIG_I2C=y
CONFIG_I2C_CHARDEV=y
CONFIG_I2C_CNC1800L=y
CONFIG_GPIOLIB=y
CONFIG_GPIO_CNC1800L=y
CONFIG_WATCHDOG=y
CONFIG_DW_WATCHDOG=y
CONFIG_USB=y
CONFIG_USB_EHCI_HCD=y
CONFIG_USB_EHCI_HCD_PLATFORM=y
CONFIG_USB_OHCI_HCD=y
CONFIG_USB_OHCI_HCD_PLATFORM=y
CONFIG_SCSI=y
CONFIG_BLK_DEV_SD=y
CONFIG_USB_STORAGE=y
CONFIG_MMC=y
CONFIG_MMC_DW=y
CONFIG_PWRSEQ_SIMPLE=y
CONFIG_DEVTMPFS=y
CONFIG_DEVTMPFS_MOUNT=y
CONFIG_TMPFS=y
CONFIG_EXT4_FS=y
CONFIG_VFAT_FS=y
CONFIG_JFFS2_FS=y
CONFIG_UBIFS_FS=y
CONFIG_NFS_FS=y
CONFIG_ROOT_NFS=y
CONFIG_NLS_CODEPAGE_437=y
CONFIG_NLS_ISO8859_1=y
CONFIG_MAGIC_SYSRQ=y
CONFIG_DEBUG_FS=y
CONFIG_DEBUG_KERNEL=y
```

## arch/arm/mach-celestial/Kconfig
```kconfig
# SPDX-License-Identifier: GPL-2.0
config ARCH_CELESTIAL
	bool "Celestial Semiconductor CNC1800L SoC"
	depends on ARCH_MULTI_V6
	select PINCTRL
	select PINCTRL_CNC1800L
	select GPIOLIB
	select GPIO_CNC1800L
	select CNC1800L_TIMER
	select COMMON_CLK_CNC1800L
	help
	  Support for the Celestial Semiconductor (later acquired by Cavium)
	  CNC1800L System-on-Chip, as used in the D-Link DSM-232 digital
	  satellite receiver (Tiga-Mini board).

	  The CNC1800L integrates a single ARM1176JZF-S core (confirmed via
	  CONFIG_ARM1176 in the vendor U-Boot port's cnc1800l board files;
	  ARCH_MULTI_V6 already selects the required CPU_V6K).
```
